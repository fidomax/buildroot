## configs/mx25kium_defconfig
```kconfig
# Architecture
BR2_arm=y
BR2_arm926t=y
#
# Mirrors and Download locations
#
BR2_SSP_NONE=y

#
# Toolchain
#
BR2_TOOLCHAIN_USES_GLIBC=y

#
# Toolchain Buildroot Options
#
BR2_TOOLCHAIN_BUILDROOT_GLIBC=y
BR2_TOOLCHAIN_BUILDROOT_LIBC="glibc"

#
# Kernel Header Options
#
#BR2_PACKAGE_HOST_LINUX_HEADERS_CUSTOM_4_9=y
BR2_PACKAGE_LINUX_HEADERS=y
BR2_PACKAGE_GLIBC=y
#BR2_GLIBC_VERSION_2_23=y
#BR2_GLIBC_VERSION_STRING="2.23"

#
# Binutils Options
#
BR2_BINUTILS_ENABLE_LTO=y

#
# GCC Options
#
BR2_TOOLCHAIN_BUILDROOT_CXX=y
BR2_GCC_ENABLE_LTO=y

#
# Toolchain Generic Options
#
BR2_TOOLCHAIN_HAS_NATIVE_RPC=y
BR2_USE_WCHAR=y
BR2_ENABLE_LOCALE=y
BR2_INSTALL_LIBSTDCPP=y
BR2_TOOLCHAIN_HAS_THREADS=y
BR2_TOOLCHAIN_HAS_THREADS_DEBUG=y
BR2_TOOLCHAIN_HAS_SSP=y
#BR2_TOOLCHAIN_HEADERS_AT_LEAST="4.8"
BR2_TOOLCHAIN_ARM_HAS_SYNC_8=y
BR2_TOOLCHAIN_HAS_SYNC_8=y

#
# System configuration
#
BR2_TARGET_GENERIC_HOSTNAME="kium"
BR2_TARGET_GENERIC_ISSUE="Welcome to KIUM"
BR2_TARGET_GENERIC_ROOT_PASSWD="root"
BR2_SYSTEM_DHCP="eth0"
BR2_ENABLE_LOCALE_WHITELIST="C en_US ru_RU"
BR2_GENERATE_LOCALE="ru_RU.UTF-8"
BR2_TARGET_TZ_INFO=y
BR2_TARGET_TZ_ZONELIST="default"
BR2_TARGET_LOCALTIME="Europe/Moscow"
BR2_TARGET_GENERIC_GETTY_PORT="ttymxc0"
BR2_TARGET_GENERIC_GETTY_TERM="linux"

# required tools to create the SD card image
BR2_PACKAGE_HOST_DOSFSTOOLS=y
BR2_PACKAGE_HOST_GENIMAGE=y
BR2_PACKAGE_HOST_MTOOLS=y

# Filesystem
BR2_ROOTFS_POST_IMAGE_SCRIPT="board/freescale/common/imx/post-image.sh"
BR2_TARGET_ROOTFS_EXT2=y
BR2_TARGET_ROOTFS_EXT2_4=y

# Bootloader
BR2_TARGET_UBOOT=y
BR2_TARGET_UBOOT_BOARDNAME="mx25pdk"
BR2_TARGET_UBOOT_BUILD_SYSTEM_KCONFIG=y
BR2_TARGET_UBOOT_CUSTOM_GIT=y
BR2_TARGET_UBOOT_CUSTOM_REPO_URL="http://192.168.1.251/kium/u-boot.git"
BR2_TARGET_UBOOT_CUSTOM_REPO_VERSION="test-imx25"
BR2_TARGET_UBOOT_VERSION="test-imx25"
BR2_TARGET_UBOOT_USE_DEFCONFIG=y
BR2_TARGET_UBOOT_BOARD_DEFCONFIG="mx25kium"
BR2_TARGET_UBOOT_FORMAT_IMX=y

# Kernel
BR2_LINUX_KERNEL=y
BR2_LINUX_KERNEL_LATEST_VERSION=y
BR2_LINUX_KERNEL_PATCH="board/ntk/kium/01-linux-FM31L278-rtc.patch board/ntk/kium/02-linux-esdhc-debug.patch"
BR2_LINUX_KERNEL_DEFCONFIG="imx_v4_v5"
BR2_LINUX_KERNEL_CONFIG_FRAGMENT_FILES="board/ntk/kium/linux.fragment"
BR2_LINUX_KERNEL_DTS_SUPPORT=y
BR2_LINUX_KERNEL_USE_CUSTOM_DTS=y
BR2_LINUX_KERNEL_CUSTOM_DTS_PATH="board/ntk/kium/imx25-kium.dts"

#
# Firmware
#
BR2_PACKAGE_LM_SENSORS=y

#
# lm-sensors tools
#
BR2_PACKAGE_LM_SENSORS_SENSORS=y

#
# Compression and decompression
#
BR2_PACKAGE_ZLIB=y

#
# Crypto
#
BR2_PACKAGE_OPENSSL=y

#
# Database
#
BR2_PACKAGE_SQLITE=y

#
# Graphics
#
BR2_PACKAGE_FONTCONFIG=y
BR2_PACKAGE_FREETYPE=y
BR2_PACKAGE_GD=y
BR2_PACKAGE_JPEG=y
BR2_PACKAGE_LIBJPEG=y
BR2_PACKAGE_HAS_JPEG=y
BR2_PACKAGE_PROVIDES_JPEG="libjpeg"
BR2_PACKAGE_LIBPNG=y
BR2_PACKAGE_TIFF=y
BR2_PACKAGE_TIFF_CCITT=y
BR2_PACKAGE_TIFF_PACKBITS=y
BR2_PACKAGE_TIFF_LZW=y
BR2_PACKAGE_TIFF_THUNDER=y
BR2_PACKAGE_TIFF_NEXT=y
BR2_PACKAGE_TIFF_LOGLUV=y
BR2_PACKAGE_TIFF_MDI=y
BR2_PACKAGE_TIFF_ZLIB=y
BR2_PACKAGE_TIFF_PIXARLOG=y
BR2_PACKAGE_TIFF_JPEG=y
BR2_PACKAGE_TIFF_OLD_JPEG=y
BR2_PACKAGE_TIFF_JBIG=y

#
# JSON/XML
#
BR2_PACKAGE_EXPAT=y
#
# Other
#
BR2_PACKAGE_FFTW=y
BR2_PACKAGE_FFTW_PRECISION_SINGLE=y
BR2_PACKAGE_FFTW_FAST=y
BR2_PACKAGE_LIBFFI=y
BR2_PACKAGE_LIBGLIB2=y
BR2_PACKAGE_TZDATA=y

#
# Text and terminal handling
#
BR2_PACKAGE_NCURSES=y
BR2_PACKAGE_NCURSES_WCHAR=y
BR2_PACKAGE_NCURSES_TARGET_PANEL=y
BR2_PACKAGE_NCURSES_TARGET_FORM=y
BR2_PACKAGE_NCURSES_TARGET_MENU=y
BR2_PACKAGE_NCURSES_TARGET_PROGS=y
BR2_PACKAGE_PCRE=y
BR2_PACKAGE_PCRE_UTF=y
BR2_PACKAGE_PCRE_UCP=y

#
# Networking applications
#
BR2_PACKAGE_CAN_UTILS=y
BR2_PACKAGE_OPENSSH=y

#
# System tools
#
BR2_PACKAGE_UTIL_LINUX=y
BR2_PACKAGE_UTIL_LINUX_LIBBLKID=y
BR2_PACKAGE_UTIL_LINUX_LIBMOUNT=y
BR2_PACKAGE_UTIL_LINUX_LIBUUID=y

#
# Text editors and viewers
#
BR2_PACKAGE_MC=y
BR2_PACKAGE_NANO=y
BR2_PACKAGE_NANO_TINY=y

#
# NTK
#
BR2_PACKAGE_OPENSCADA=y
```

## package/canmon/Config.in
```kconfig
config BR2_PACKAGE_CANMON
	bool "canmon"
	help
	  CanMon is MSO CAN Bus Monitor for Linux
```

## package/openscada/Config.in
```kconfig
config BR2_PACKAGE_OPENSCADA
	bool "openscada"
	depends on BR2_USE_WCHAR # libglib2
	depends on BR2_TOOLCHAIN_HAS_THREADS # libglib2
	depends on BR2_USE_MMU # libglib2, slang
	select BR2_PACKAGE_GD
	select BR2_PACKAGE_ZLIB
	select BR2_PACKAGE_SQLITE
	select BR2_PACKAGE_OPENSSL
	select BR2_PACKAGE_LM_SENSORS
	select BR2_PACKAGE_FFTW
	help
	  OpenSCADA

	  http://oscada.org
```
